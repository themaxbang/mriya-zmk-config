## boards/shields/mriya/Kconfig.shield
```kconfig
# Copyright (c) 2020 Pete Johanson
# SPDX-License-Identifier: MIT

config SHIELD_MRIYA_LEFT
    def_bool $(shields_list_contains,mriya_left)

config SHIELD_MRIYA_RIGHT
    def_bool $(shields_list_contains,mriya_right)
```

## config/boards/shields/mriya/Kconfig.defconfig
```kconfig
if SHIELD_CORNE_CENTRAL_DONGLE

config ZMK_KEYBOARD_NAME
    default "MRIYA"

config ZMK_SPLIT_ROLE_CENTRAL
    default y

endif

if SHIELD_MRIYA_CENTRAL_DONGLE || SHIELD_MRIYA_PERIPHERAL_LEFT || SHIELD_MRIYA_PERIPHERAL_RIGHT

config ZMK_SPLIT
    default y

endif
```

## config/boards/shields/mriya/Kconfig.shield
```kconfig
# Copyright (c) 2020 Pete Johanson
# SPDX-License-Identifier: MIT

config SHIELD_MRIYA_CENTRAL_DONGLE
    def_bool $(shields_list_contains,mriya_central_dongle)

config SHIELD_MRIYA_CENTRAL_LEFT
    def_bool $(shields_list_contains,mriya_central_left)    

config SHIELD_MRIYA_PERIPHERAL_LEFT
    def_bool $(shields_list_contains,mriya_peripheral_left)

config SHIELD_MRIYA_PERIPHERAL_RIGHT
    def_bool $(shields_list_contains,mriya_peripheral_right)
```

## config/west.yml
```yaml
manifest:
  remotes:
    - name: zmkfirmware
      url-base: https://github.com/zmkfirmware
    - name: m165437 #new entry
      url-base: https://github.com/M165437 #new entry
  projects:
    - name: zmk
      remote: zmkfirmware
      revision: v0.3.0
      import: app/west.yml
    - name: nice-view-gem #new entry
      remote: m165437 #new entry
      revision: v0.3.0 #new entry
  self:
    path: config
```
